## EveNordic_CustomWidgets/dts/bindings/display/ft81x.yaml
```yaml
description: FT81x EVE Display Controller

compatible: "ftdi,ft81x"

include: spi-device.yaml

properties:
  reg:
    required: true

  pd-gpios:
    type: phandle-array
    required: true
    description: Power down pin

  int-gpios:
    type: phandle-array
    required: true
    description: Interrupt pin 
```

## EveNordic_Example/build_7/EveNordic_Example/Kconfig/Kconfig.shield
```kconfig
osource "C:/NRFTestCode/EveNordic_Example/boards/shields/*/Kconfig.shield"
osource "C:/ncs/v2.8.0/nrf/boards/shields/*/Kconfig.shield"
```

## EveNordic_Example/dts/bindings/display/bridgetek,eve.yaml
```yaml
description: Bridgetek EVE display controller

compatible: "bridgetek,eve"

include: spi-device.yaml

properties:
  reg:
    required: true

  pd-gpios:
    type: phandle-array
    required: true
    description: Power down pin

  int-gpios:
    type: phandle-array
    required: true
    description: Interrupt pin 
```
